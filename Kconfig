## Kconfig
```kconfig
menu "RTOS SDK Core Library Configuration"
    config APP_MODULE
        string "App module name"
        default "DEFAULT"

    config SYSTEM_DOMAIN
        string "System backend domain"
        default "home.quangiaso.com"
    config SYSTEM_PORT
        int "System backend port"
        default 80
    config SUPPORT_CONFIG_PORTAL
        bool "Is support config portal"
        default n

    config SUPPORT_OTA_UPDATE
        bool "Is support OTA update"
        default n

    config SMART_CONFIG_KEY
        string "Smart config encrypt key"
        default "L+-@09"

    config SUPPORT_LOCAL_MDNS
        bool "Is support mDNS service"
        default n

endmenu
```
